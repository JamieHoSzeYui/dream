## drivers/vibrator/Kconfig
```kconfig
config ONEPLUS_VIBRATE
       default y
       tristate "Vibration driver"
       depends on I2C
       help
       OnePlus vibration driver ported from SM8150
```
